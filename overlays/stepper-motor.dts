/dts-v1/;
/plugin/;

/ {
   compatible = "brcm,bcm2835", "brcm,bcm2836", "brcm,bcm2708", "brcm,bcm2709", "brcm,bcm2710", "bcrm,bcm2837";

    fragment@0 {
        target = <&soc>;
        __overlay__ {
            stepper0 {
                compatible = "generic,stepper-motor";

                step-gpios = <&gpio 17 0 >; // STEP on GPIO17
                dir-gpios = <&gpio 27 0 >; // DIR on GPIO27
            };
        };
    };
};
